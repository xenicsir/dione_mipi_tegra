## meta-xenics-tegra/meta/conf/layer.conf
```bitbake
# We have a conf and classes directory, add to BBPATH
BBPATH .= ":${LAYERDIR}"

# We have recipes-* directories, add to BBFILES
BBFILES += "${LAYERDIR}/recipes-*/*/*.bb \
	${LAYERDIR}/recipes-*/*/*.bbappend"

BBFILE_COLLECTIONS += "xenics-tegra"
BBFILE_PATTERN_xenics-tegra = "^${LAYERDIR}/"
BBFILE_PRIORITY_xenics-tegra = "6"

RM_WORK_EXCLUDE += "linux-tegra busybox nvgstapps sysvinit-inittab xenics-root-files"

ROOTFSPART_SIZE = "3984588800"
TEGRAFLASH_SDCARD_SIZE = "4100M"
```

## yocto/kirkstone/meta/conf/layer.conf
```bitbake
# We have a conf and classes directory, add to BBPATH
BBPATH .= ":${LAYERDIR}"

# We have recipes-* directories, add to BBFILES
BBFILES += "${LAYERDIR}/recipes-*/*/*.bb \
	${LAYERDIR}/recipes-*/*/*.bbappend"

BBFILE_COLLECTIONS += "pcbd-tegra"
BBFILE_PATTERN_pcbd-tegra = "^${LAYERDIR}/"
BBFILE_PRIORITY_pcbd-tegra = "6"

RM_WORK_EXCLUDE += "linux-tegra busybox nvgstapps sysvinit-inittab pcbd-root-files"

ROOTFSPART_SIZE = "3984588800"
TEGRAFLASH_SDCARD_SIZE = "4100M"

LAYERSERIES_COMPAT_pcbd-tegra = "kirkstone"
```
